/dts-v1/;

/*****************************************************************
** Include a chip configuration file                             
*****************************************************************/
/include/ "prx300-bootcore.dtsi"

/ {
	model = "PRX321-bootcore";
};
